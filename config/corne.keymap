#define CONFIG_WIRELESS

#include <behaviors.dtsi>
#include <behaviors/num_word.dtsi> // Requires auto-layer module.
#include <dt-bindings/zmk/keys.h>
#include <dt-bindings/zmk/bt.h>
#include <dt-bindings/zmk/outputs.h>
#include "zmk-helpers/helper.h"
#include "zmk-helpers/key-labels/36.h"

/* Layers */

#define DEF 0
#define SYM 1
#define NUM 2
#define SYS 3
#define MOUSE 4

/* Aliases */

#define XXX &none
#define ___ &trans

/* Global defaults */

#define QUICK_TAP_MS 175

&sk {
  release-after-ms = <900>;
  quick-release;
};

&sl { // Allow sticky mods to chord across sticky layers.
  ignore-modifiers;
};

&lt {
  flavor = "balanced";
  tapping-term-ms = <200>;
  quick-tap-ms = <QUICK_TAP_MS>;
};

/* Bluetooth */

#define _BT_SEL_KEYS_                                                        \
    &bt BT_SEL 0 &bt BT_SEL 1 &bt BT_SEL 2 &bt BT_SEL 3 &bt BT_CLR

/* Homerow mods */

#define KEYS_L LT0 LT1 LT2 LT3 LT4 LM0 LM1 LM2 LM3 LM4 LB0 LB1 LB2 LB3 LB4  // Left-hand keys.
#define KEYS_R RT0 RT1 RT2 RT3 RT4 RM0 RM1 RM2 RM3 RM4 RB0 RB1 RB2 RB3 RB4  // Right-hand keys.
#define THUMBS LH2 LH1 LH0 RH0 RH1 RH2                                      // Thumb keys.

/* Left-hand HRMs. */
ZMK_HOLD_TAP(hml,
    flavor = "balanced";
    tapping-term-ms = <280>;
    quick-tap-ms = <175>;
    require-prior-idle-ms = <150>;
    bindings = <&kp>, <&kp>;
    hold-trigger-key-positions = <KEYS_R THUMBS>;
    hold-trigger-on-release;
)

/* Right-hand HRMs. */
ZMK_HOLD_TAP(hmr,
    flavor = "balanced";
    tapping-term-ms = <280>;
    quick-tap-ms = <175>;
    require-prior-idle-ms = <150>;
    bindings = <&kp>, <&kp>;
    hold-trigger-key-positions = <KEYS_L THUMBS>;
    hold-trigger-on-release;
)

// Hack: Make HRM combos tap-only (cf, ZMK issue #544).
// #define ZMK_COMBO_8(NAME, TAP, POS, LAYERS, COMBO_MS, IDLE_MS, HOLD, SIDE)     \
//   MAKE_HRM(hm_combo_##NAME, &kp, TAP, SIDE THUMBS)                             \
//   ZMK_COMBO_6(NAME, &hm_combo_##NAME HOLD 0, POS, LAYERS, COMBO_MS, IDLE_MS)

/* Combos, leader key sequences, mouse emulation */

// #include "combos.dtsi" // Must be sourced after HRM-combo hack.
// #include "leader.dtsi"
#include "mouse.dtsi"

/* Nav cluster */

// Trigger tap-action on all interrupts.
#define MT_CORE                                                                \
  flavor = "tap-preferred";                                                    \
  tapping-term-ms = <220>;                                                     \
  quick-tap-ms = <220>;                                                        \
  hold-trigger-key-positions = <0>;

&mt { MT_CORE };

// ZMK_HOLD_TAP(mt_home, bindings = <&masked_home>, <&kp>; MT_CORE)
// ZMK_HOLD_TAP(mt_end, bindings = <&masked_end>, <&kp>; MT_CORE)

// #define NAV_LEFT  &mt_home 0   LEFT  // Tap: left  | Long-tap: start of line.
// #define NAV_RIGHT &mt_end 0    RIGHT // Tap: right | Long-tap: end   of line.
// #define NAV_UP    &mt LC(HOME) UP    // Tap: up    | Long-tap: start of doc.
// #define NAV_DOWN  &mt LC(END)  DOWN  // Tap: down  | Long-tap: end   of doc.
// #define NAV_BSPC  &mt LC(BSPC) BSPC  // Tap: bspc  | Long-tap: delete word bwd.
// #define NAV_DEL   &mt LC(DEL)  DEL   // Tap: del   | Long-tap: delete word fwd.

// // Mask CTRL on left/right hold to avoid accidental jumps to start/end of doc.
// #define MASK_MODS(NAME, MODS, BINDING)                                         \
//   ZMK_MOD_MORPH(NAME, bindings = <BINDING>, <BINDING>; mods = <MODS>;)

// MASK_MODS(masked_home, (MOD_LCTL), &kp HOME)
// MASK_MODS(masked_end,  (MOD_LCTL), &kp END)

/* Magic-shift & auto-layers */

// // Tap: repeat after alpha, else sticky-shift |
// // Shift + tap/ double-tap: caps-word | Hold: shift.
// #define MAGIC_SHIFT &magic_shift LSHFT 0
// ZMK_HOLD_TAP(magic_shift, bindings = <&kp>, <&magic_shift_tap>;
//              flavor = "balanced"; tapping-term-ms = <200>;
//              quick-tap-ms = <QUICK_TAP_MS>;)
// ZMK_MOD_MORPH(magic_shift_tap, bindings = <&shift_repeat>, <&caps_word>;
//               mods = <(MOD_LSFT)>;)
// ZMK_ADAPTIVE_KEY(
//     shift_repeat, bindings = <&sk LSHFT>;
//     repeat {
//       trigger-keys = <A B C D E F G H I J K L M N O P Q R S T U V W X Y Z>;
//       bindings = <&key_repeat>;
//       max-prior-idle-ms = <1200>;
//       strict-modifiers;
//     };)
// &caps_word { // Mods deactivate caps-word, requires PR #1451. [TODO: rebase]
//   /delete-property/ ignore-modifiers;
// };

// // Tap: num-word | double-tap: sticky num-layer | Hold: num-layer.
// #define SMART_NUM &smart_num NUM 0
// ZMK_HOLD_TAP(smart_num, bindings = <&mo>, <&num_dance>; flavor = "balanced";
//              tapping-term-ms = <200>; quick-tap-ms = <QUICK_TAP_MS>;)
// ZMK_TAP_DANCE(num_dance, bindings = <&num_word NUM>, <&sl NUM>;
//               tapping-term-ms = <200>;)

// // Smart-mouse, requires tri-state module.
// ZMK_TRI_STATE(
//     smart_mouse, bindings = <&tog MOUSE>, <&none>, <&tog MOUSE>;
//     ignored-key-positions =
//         <LT1 LT2 LH0 LH1 RT1 RT2 RT3 RM0 RM1 RM2 RM3 RM4 RB1 RB2 RB3 RH0 RH1>;
//     ignored-layers = <MOUSE NAV FN>;)

/* Custom behaviors */

// // Alt+Tab swapper, requires tri-state module.
// ZMK_TRI_STATE(swapper, bindings = <&kt LALT>, <&kp TAB>, <&kt LALT>;
//               ignored-key-positions = <LT2 RT2 RM1 RM2 RM3>;)

// // Define mod-morph with a *single* mod trigger for less repetition.
// #define SIMPLE_MORPH(NAME, MOD, BINDING1, BINDING2)                            \
//   ZMK_MOD_MORPH(NAME, mods = <(MOD_L##MOD | MOD_R##MOD)>;                      \
//                 bindings = <BINDING1>, <BINDING2>;)

// // Tap: comma | Shift + tap: semicolon | Ctrl + shift + tap: <.
// SIMPLE_MORPH(comma_morph, SFT, &kp COMMA, &comma_inner_morph)
// SIMPLE_MORPH(comma_inner_morph, CTL, &kp SEMICOLON, &kp LESS_THAN)

// // Tap: dot | Shift + tap: colon | Ctrl + shift + tap: >.
// SIMPLE_MORPH(dot_morph, SFT, &kp DOT, &dot_inner_morph)
// SIMPLE_MORPH(dot_inner_morph, CTL, &kp COLON, &kp GREATER_THAN)

// // Tap: qmark | Shift + tap: excl.
// SIMPLE_MORPH(qexcl, SFT, &kp QMARK, &kp EXCL)

// // Tap: left/right parenthesis | Shft + tap: less-than/greater-than.
// SIMPLE_MORPH(lpar_lt, SFT, &kp LPAR, &kp LT)
// SIMPLE_MORPH(rpar_gt, SFT, &kp RPAR, &kp GT)

// // Tap: space | Shift + tap: dot -> space -> sticky shift | Hold: nav layer.
// ZMK_HOLD_TAP(lt_spc, bindings = <&mo>, <&spc_morph>; flavor = "balanced";
//              tapping-term-ms = <200>; quick-tap-ms = <QUICK_TAP_MS>;)
// SIMPLE_MORPH(spc_morph, SFT, &kp SPACE, &dot_spc)
// ZMK_MACRO(dot_spc, bindings = <&kp DOT &kp SPACE &sk LSHFT>; wait-ms = <0>;
//           tap-ms = <5>;)

// // Tap: backspace | Lshft + tap: delete | Rshft + tap: shift-delete.
// ZMK_MOD_MORPH(bs_del, bindings = <&kp BSPC>, <&kp DEL>;
//               mods = <(MOD_LSFT|MOD_RSFT)>; keep-mods = <MOD_RSFT>;)

// // Tap: copy | double-tap: cut.
// ZMK_TAP_DANCE(copy_cut, bindings = <&kp LC(INS)>, <&kp LC(X)>;
//               tapping-term-ms = <200>;)

// // Sticky shift + leader.
// ZMK_MACRO(leader_sft, bindings = <&sk LSHFT &leader>;)

// // Misc aliases. [TODO: clean up]
// #define CANCEL    &kp K_CANCEL            // Cancel caps-word & auto-layers.
// #define DSK_PREV  &hmr LCTRL LG(LC(LEFT)) // Previous desktop.
// #define DSK_NEXT  &hmr LALT LG(LC(RIGHT)) // Next     desktop.
// #define PIN_WIN   &kp LG(LC(LS(Q)))       // Pin window across desktops.
// #define PIN_APP   &kp LG(LC(LS(A)))       // Pin application across desktops.
// #define DSK_MGR   &kp LA(GRAVE)           // Desktop manager.
// #define VOL_DOWN  &hmr RSHFT C_VOL_DN

/* Keymap */

ZMK_CONDITIONAL_LAYER(sys, SYM NUM, SYS) // SYM + NUM --> SYS.

#ifndef ZMK_BASE_LAYER
  #define ZMK_BASE_LAYER(name, LT, RT, LM, RM, LB, RB, LH, RH) \
      ZMK_LAYER(name, LT RT LM RM LB RB LH RH)
#endif

ZMK_BASE_LAYER(Base,
//╭──────────────────┬──────────────────┬──────────────────┬──────────────────┬──────────────────╮    ╭──────────────────┬──────────────────┬──────────────────┬──────────────────┬──────────────────╮
    &kp QUOT           &kp COMMA          &kp DOT            &kp P              &kp Y            ,      &kp F              &kp G              &kp C              &kp R              &kp L            ,
//├──────────────────┼──────────────────┼──────────────────┼──────────────────┼──────────────────┤    ├──────────────────┼──────────────────┼──────────────────┼──────────────────┼──────────────────┤
    &hml LCTRL A       &hml LGUI O        &hml LALT E        &kp U              &kp I            ,      &kp D              &kp H              &hmr LALT T        &hmr LGUI N        &hmr LCTRL S     ,
//├──────────────────┼──────────────────┼──────────────────┼──────────────────┼──────────────────┤    ├──────────────────┼──────────────────┼──────────────────┼──────────────────┼──────────────────┤
    &kp SEMI           &kp Q              &kp J              &kp K              &kp X            ,      &kp B              &kp M              &kp W              &kp V              &kp Z            ,
//╰──────────────────┼──────────────────┴──────────────────┼──────────────────┼──────────────────┤    ├──────────────────┼──────────────────┼──────────────────┴─────────────────────────────────────╯
                                          &kp TAB            &hml LSHFT SPACE   &kp BSPC         ,      &kp ESC            &lt SYM RET        &lt NUM DEL
//                                      ╰──────────────────┴──────────────────┴──────────────────╯    ╰──────────────────┴──────────────────┴──────────────────╯
)

ZMK_BASE_LAYER(Sym,
//╭──────────────────┬──────────────────┬──────────────────┬──────────────────┬──────────────────╮    ╭──────────────────┬──────────────────┬──────────────────┬──────────────────┬──────────────────╮
    &kp GRAVE          &kp EXCL           &kp QMARK          &kp AT             &kp LBKT         ,      &kp RBKT           XXX                XXX                XXX                &kp RIGHT        ,
//├──────────────────┼──────────────────┼──────────────────┼──────────────────┼──────────────────┤    ├──────────────────┼──────────────────┼──────────────────┼──────────────────┼──────────────────┤
    &kp EQUAL          &kp PIPE           &kp CARET          &kp UNDER          &kp LPAR         ,      &kp RPAR           &kp LEFT           &kp DOLLAR         &kp AMPS           &kp MINUS        ,
//├──────────────────┼──────────────────┼──────────────────┼──────────────────┼──────────────────┤    ├──────────────────┼──────────────────┼──────────────────┼──────────────────┼──────────────────┤
    &kp FSLH           &kp HASH           &kp DOWN           &kp UP             &kp LBRC         ,      &kp RBRC           &kp PLUS           &kp PRCNT          &kp STAR           &kp BSLH         ,
//╰──────────────────┼──────────────────┴──────────────────┼──────────────────┼──────────────────┤    ├──────────────────┼──────────────────┼──────────────────┴─────────────────────────────────────╯
                                          ___                ___                ___              ,      ___                ___                ___
//                                      ╰──────────────────┴──────────────────┴──────────────────╯    ╰──────────────────┴──────────────────┴──────────────────╯
)

ZMK_BASE_LAYER(Num,
//╭──────────────────┬──────────────────┬──────────────────┬──────────────────┬──────────────────╮    ╭──────────────────┬──────────────────┬──────────────────┬──────────────────┬──────────────────╮
    &kp F1             &kp F2             &kp F3             &kp F4             XXX              ,      XXX                &kp N7             &kp N8             &kp N9             &kp COMMA        ,
//├──────────────────┼──────────────────┼──────────────────┼──────────────────┼──────────────────┤    ├──────────────────┼──────────────────┼──────────────────┼──────────────────┼──────────────────┤
    &kp F5             &kp F6             &kp F7             &kp F8             XXX              ,      XXX                &kp N4             &kp N5             &kp N6             &kp N0           ,
//├──────────────────┼──────────────────┼──────────────────┼──────────────────┼──────────────────┤    ├──────────────────┼──────────────────┼──────────────────┼──────────────────┼──────────────────┤
    &kp F9             &kp F10            &kp F11            &kp F12            XXX              ,      XXX                &kp N1             &kp N2             &kp N3             &kp DOT          ,
//╰──────────────────┼──────────────────┴──────────────────┼──────────────────┼──────────────────┤    ├──────────────────┼──────────────────┼──────────────────┴─────────────────────────────────────╯
                                          ___                ___                ___              ,      ___                ___                ___
//                                      ╰──────────────────┴──────────────────┴──────────────────╯    ╰──────────────────┴──────────────────┴──────────────────╯
)

ZMK_BASE_LAYER(Sys,
//╭──────────────────┬──────────────────┬──────────────────┬──────────────────┬──────────────────╮    ╭──────────────────┬──────────────────┬──────────────────┬──────────────────┬──────────────────╮
                                          _BT_SEL_KEYS_                                          ,      XXX                XXX                XXX                XXX                &kp RIGHT        ,
//├──────────────────┼──────────────────┼──────────────────┼──────────────────┼──────────────────┤    ├──────────────────┼──────────────────┼──────────────────┼──────────────────┼──────────────────┤
    &kp HOME           &kp PG_DN          XXX                XXX                &bootloader      ,      &bootloader        &kp LEFT           XXX                &kp PG_UP          &kp END          ,
//├──────────────────┼──────────────────┼──────────────────┼──────────────────┼──────────────────┤    ├──────────────────┼──────────────────┼──────────────────┼──────────────────┼──────────────────┤
    XXX                XXX                &kp DOWN           &kp UP             &sys_reset       ,      &sys_reset         XXX                XXX                XXX                &kp INS          ,
//╰──────────────────┼──────────────────┴──────────────────┼──────────────────┼──────────────────┤    ├──────────────────┼──────────────────┼──────────────────┴─────────────────────────────────────╯
                                          ___                ___                ___              ,      ___                ___                ___
//                                      ╰──────────────────┴──────────────────┴──────────────────╯    ╰──────────────────┴──────────────────┴──────────────────╯
)

ZMK_BASE_LAYER(Mouse,
//╭──────────────────┬──────────────────┬──────────────────┬──────────────────┬──────────────────╮    ╭──────────────────┬──────────────────┬──────────────────┬──────────────────┬──────────────────╮
    XXX                XXX                XXX                XXX                XXX              ,      XXX                U_WH_D             U_MS_U             U_WH_U             XXX              ,
//├──────────────────┼──────────────────┼──────────────────┼──────────────────┼──────────────────┤    ├──────────────────┼──────────────────┼──────────────────┼──────────────────┼──────────────────┤
    XXX                XXX                XXX                XXX                XXX              ,      U_WH_L             U_MS_L             U_MS_D             U_MS_R             U_WH_R           ,
//├──────────────────┼──────────────────┼──────────────────┼──────────────────┼──────────────────┤    ├──────────────────┼──────────────────┼──────────────────┼──────────────────┼──────────────────┤
    XXX                XXX                XXX                XXX                XXX              ,      XXX                &mkp LCLK          &mkp MCLK          &mkp RCLK          XXX              ,
//╰──────────────────┼──────────────────┴──────────────────┼──────────────────┼──────────────────┤    ├──────────────────┼──────────────────┼──────────────────┴─────────────────────────────────────╯
                                          ___                ___                ___              ,      ___                ___                ___
//                                      ╰──────────────────┴──────────────────┴──────────────────╯    ╰──────────────────┴──────────────────┴──────────────────╯
)

/{ chosen { zmk,physical-layout = &foostan_corne_5col_layout; }; };

/* vim: set ft=c tw=146: */
